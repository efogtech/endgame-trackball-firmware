## CMakeLists.txt
```
cmake_minimum_required(VERSION 3.20.0)
find_package(Zephyr REQUIRED HINTS $ENV{ZEPHYR_BASE})
project(dongle_esb_hid)

zephyr_compile_options(-Wno-address-of-packed-member)

# ESB + MPSL come from the zmk-esb-endpoint module's vendored tree.
set(ESB_MODULE_DIR ${CMAKE_SOURCE_DIR}/../zmk-esb-endpoint)
set(NRFXLIB_DIR    ${ESB_MODULE_DIR}/vendor/nrfxlib)
set(NRF_ESB_DIR    ${ESB_MODULE_DIR}/vendor/nrf-esb)

if(CONFIG_FPU AND CONFIG_FPU_SHARING)
    set(MPSL_FLOAT_DIR "hard-float")
elseif(CONFIG_FPU)
    set(MPSL_FLOAT_DIR "softfp-float")
else()
    set(MPSL_FLOAT_DIR "soft-float")
endif()

set(MPSL_LIB     ${NRFXLIB_DIR}/mpsl/lib/nrf52/${MPSL_FLOAT_DIR}/libmpsl.a)
set(MPSL_FEM_LIB ${NRFXLIB_DIR}/mpsl/fem/common/lib/nrf52/${MPSL_FLOAT_DIR}/libmpsl_fem_common.a)
if(NOT EXISTS ${MPSL_FEM_LIB})
    message(FATAL_ERROR "MPSL FEM library not found: ${MPSL_FEM_LIB}")
endif()
zephyr_link_libraries(${MPSL_FEM_LIB})
zephyr_link_libraries(${MPSL_LIB})

if(CONFIG_HAS_HW_NRF_PPI)
    set(NRF_ESB_PPI_SRC ${NRF_ESB_DIR}/subsys/esb_ppi.c)
else()
    set(NRF_ESB_PPI_SRC ${NRF_ESB_DIR}/subsys/esb_dppi.c)
endif()

target_sources(app PRIVATE
    ${NRF_ESB_DIR}/subsys/esb.c
    ${NRF_ESB_PPI_SRC}
    ${ESB_MODULE_DIR}/src/esb/channel_hop.c
    src/main.c
    src/esb_prx.c
    src/usb_hid.c
    src/led_status.c
    src/shell_relay.c
    src/bench.c
    src/channel_hop_dongle.c
)

target_include_directories(app PRIVATE
    ${NRF_ESB_DIR}/include
    ${NRF_ESB_DIR}/subsys
    ${ESB_MODULE_DIR}/include
)

zephyr_include_directories(${NRFXLIB_DIR}/mpsl/include)
zephyr_include_directories(${NRFXLIB_DIR}/mpsl/fem/include)
zephyr_include_directories(${NRFXLIB_DIR}/mpsl/fem/include/protocol)
```

## Kconfig
```
# SPDX-License-Identifier: MIT

mainmenu "Endgame Dongle"

source "Kconfig.zephyr"

config DONGLE_UNPAIR_HOLD_MS
    int "Button hold duration to unpair (ms)"
    default 5000
    range 1000 30000
    help
      How long the pair button must be held while paired to forget the peer.

config DONGLE_NOLED
    bool "Disable dongle status LED entirely"
    default n
    help
      Forces &led_strip to stay disabled. The WS2812 devicetree node is
      disabled in the overlay and led_status_*() become compile-time
      no-ops, so no SPI traffic is ever generated for the status LED.

config DONGLE_LED_BRIGHTNESS
    int "Status LED brightness percent (0-100)"
    default 7
    range 0 100
    help
      Scales the WS2812 RGB channels for the status LED.

config DONGLE_NO_ACTIVE_EFFECTS
    bool "Suspend status LED bus while paired"
    default n
    select PM_DEVICE
    help
      When enabled and the dongle is paired, the LED is driven dark and
      the WS2812's SPI bus is put into PM suspend (sleep pinctrl state).
      The LED thread keeps running but performs no SPI traffic until
      the dongle becomes unpaired again. Hop flashes, shell-relay
      indicators and the connected/idle colors are all suppressed for
      the duration. Unpaired/armed states are unaffected.

config DONGLE_LED_TICK_MS
    int "LED thread tick interval (ms)"
    default 10
    range 1 100

config DONGLE_LED_BLINK_HALF_PERIOD_MS
    int "LED blink half-period for armed/pairing state (ms)"
    default 150
    range 50 1000

config DONGLE_LED_CONNECTED_TIMEOUT_MS
    int "Duration after last RX before LED switches to idle color (ms)"
    default 100
    range 100 10000

config DONGLE_LED_UNPAIRED_R
    int "Unpaired state LED red component (0-255)"
    default 0
    range 0 255

config DONGLE_LED_UNPAIRED_G
    int "Unpaired state LED green component (0-255)"
    default 0
    range 0 255

config DONGLE_LED_UNPAIRED_B
    int "Unpaired state LED blue component (0-255)"
    default 255
    range 0 255

config DONGLE_LED_ARMED_R
    int "Armed/pairing blink LED red component (0-255)"
    default 0
    range 0 255

config DONGLE_LED_ARMED_G
    int "Armed/pairing blink LED green component (0-255)"
    default 0
    range 0 255

config DONGLE_LED_ARMED_B
    int "Armed/pairing blink LED blue component (0-255)"
    default 255
    range 0 255

config DONGLE_LED_SHELL_RELAY_R
    int "Shell relay active LED red component (0-255)"
    default 128
    range 0 255

config DONGLE_LED_SHELL_RELAY_G
    int "Shell relay active LED green component (0-255)"
    default 0
    range 0 255

config DONGLE_LED_SHELL_RELAY_B
    int "Shell relay active LED blue component (0-255)"
    default 255
    range 0 255

config DONGLE_LED_SHELL_PENDING_R
    int "Shell relay pending (requested but unconfirmed) LED red component (0-255)"
    default 255
    range 0 255

config DONGLE_LED_SHELL_PENDING_G
    int "Shell relay pending (requested but unconfirmed) LED green component (0-255)"
    default 80
    range 0 255

config DONGLE_LED_SHELL_PENDING_B
    int "Shell relay pending (requested but unconfirmed) LED blue component (0-255)"
    default 0
    range 0 255

config DONGLE_LED_CONNECTED_R
    int "Connected/active LED red component (0-255)"
    default 0
    range 0 255

config DONGLE_LED_CONNECTED_G
    int "Connected/active LED green component (0-255)"
    default 255
    range 0 255

config DONGLE_LED_CONNECTED_B
    int "Connected/active LED blue component (0-255)"
    default 0
    range 0 255

config DONGLE_LED_IDLE_R
    int "Paired-idle LED red component (0-255)"
    default 127
    range 0 255

config DONGLE_LED_IDLE_G
    int "Paired-idle LED green component (0-255)"
    default 255
    range 0 255

config DONGLE_LED_IDLE_B
    int "Paired-idle LED blue component (0-255)"
    default 0
    range 0 255

config DONGLE_LED_NOLINK_R
    int "No-link indicator LED red component (0-255)"
    default 255
    range 0 255

config DONGLE_LED_NOLINK_G
    int "No-link indicator LED green component (0-255)"
    default 90
    range 0 255

config DONGLE_LED_NOLINK_B
    int "No-link indicator LED blue component (0-255)"
    default 0
    range 0 255

config DONGLE_LED_NOLINK_FLASH_MS
    int "No-link indicator flash duration (ms)"
    default 300
    range 50 2000
    help
      Dual-purpose status indicator: a one-shot flash of this duration
      fires on every channel hop (speculative or cooperative), and the
      same color is held solid while the dongle is paired but cannot
      reach the peer (rollback dwell, post-validate-fail revert window).
      Flash overrides all other LED states for the duration; solid
      overrides connected/idle but yields to shell relay/pending.

config DONGLE_LED_STACK_SIZE
    int "LED status thread stack size (bytes)"
    default 1024
    range 512 4096

config DONGLE_LED_THREAD_PRIORITY
    int "LED status thread preemptive priority"
    default 14
    range 0 15

config DONGLE_ESB_RF_CHANNEL
    int "ESB RF channel (0-100)"
    default 78
    range 0 100
    help
      RF channel used by the PRX. Must match the PTX channel.

config DONGLE_CHANNEL_HOP
    bool "Dynamic channel hopping follower"
    default y
    help
      Mirror of ZMK_ESB_ENDPOINT_CHANNEL_HOP on the dongle. The PTX
      (keyboard) drives PROPOSAL / CONFIRM negotiation of the committed
      next channel. The dongle hops to it when an RX-silence watchdog
      trips — but only while the peer is known to be active. The
      endpoint sends ESB_PKT_IDLE when the user has been idle for
      ZMK_ESB_ENDPOINT_IDLE_THRESHOLD_MS, and the dongle disarms its
      watchdog on receipt, so a quiet but healthy link never false-hops.

if DONGLE_CHANNEL_HOP

config DONGLE_CHANNEL_HOP_RX_SILENCE_MS
    int "RX silence before hopping to committed-next (ms)"
    default 190
    range 50 60000
    help
      Silence threshold for the watchdog. Only runs while the peer is
      NOT flagged idle. Must be comfortably larger than the keyboard's
      ZMK_ESB_ENDPOINT_IDLE_THRESHOLD_MS so the IDLE packet that fires
      at the keyboard's active→idle transition has a wide window to
      arrive before this watchdog assumes the link went silent for a
      real reason — the slack between the two is the IDLE delivery
      margin. The keyboard's TX-fail hop trigger still reacts first, so
      this watchdog is the safety net, not the primary detector.

config DONGLE_CHANNEL_QUARANTINE_MS
    int "Quarantine hold time for a bad channel (ms)"
    default 300000
    range 1000 600000

config DONGLE_CHANNEL_QUARANTINE_MIN_DISTANCE
    int "Minimum distance from any quarantined channel (MHz)"
    default 5
    range 0 20

config DONGLE_CHANNEL_HOP_VALIDATE_MS
    int "Speculative-hop validation window (ms)"
    default 110
    range 50 10000
    help
      After the silence watchdog trips and the dongle hops to the
      committed next channel, it waits this long for any RX to arrive
      on the new channel. If at least one packet is received, the hop
      is confirmed: the old channel is quarantined. If nothing arrives,
      the dongle reverts to the previous channel (the silence was
      probably a genuinely-gone endpoint, e.g. HOP_NOW was never sent
      and the user actually walked away), the committed_next is cleared,
      and the old channel is NOT quarantined.

config DONGLE_CHANNEL_HOP_ROLLBACK_SILENCE_MS
    int "Long-silence rollback threshold (ms)"
    default 340
    range 100 60000
    help
      After this much time with no RX while paired-active, the dongle
      enters rollback mode. A rebooted keyboard comes up on the DTS
      default channel (DONGLE_ESB_RF_CHANNEL), so we alternate 50/50
      between the last channel we were on when rollback started and
      the default channel until any RX arrives — whichever one wins
      is where the keyboard is. Must exceed CHANNEL_HOP_RX_SILENCE_MS
      so the short-timeout committed_next speculative hop gets the
      first attempt.

config DONGLE_CHANNEL_HOP_ROLLBACK_DWELL_MS
    int "Rollback dwell per channel (ms)"
    default 8
    range 4 5000
    help
      Time spent listening on each of the two rollback candidates
      (last / default) before flipping to the other. Lower values find
      the keyboard faster but do more radio work; it still needs to be
      long enough to catch one of the endpoint's fast-retry PROPOSALs.

config DONGLE_CHANNEL_HOP_VALIDATE_FAIL_ROLLBACK_MS
    int "Rollback delay after a failed speculative-hop validation (ms)"
    default 60
    range 0 60000
    help
      A failed speculative-hop validation is positive evidence that the
      keyboard is not where committed_next pointed — sitting on the full
      ROLLBACK_SILENCE_MS before starting the rollback dwell wastes time
      when we already know the standard recovery is needed. After
      validate_work_fn reverts, re-arm the rollback-silence
      watchdog with this much shorter timeout so the dwell cycle starts
      promptly. Set to 0 to disable (rollback then waits the full
      ROLLBACK_SILENCE_MS).

config DONGLE_CHANNEL_HOP_SPECULATIVE_COOLDOWN_MS
    int "Cooldown after a speculative hop resolves (ms)"
    default 1500
    range 0 60000
    help
      After a speculative hop is validated or reverted, block the silence
      watchdog from firing another speculative hop for this long. Without
      it, a stale PROPOSAL arriving inside the post-failure window can
      repopulate committed_next and trigger a back-to-back speculative
      hop on a still-wrong target before the rollback dwell has had a
      chance to find the keyboard. The cooldown defers — does not cancel —
      so a fresh, valid committed_next will still be acted on once it
      expires. Set to 0 to disable.

config DONGLE_COOP_HOP_PRX_SETUP_BUDGET_MS
    int "Cooperative hop: PRX channel-switch budget (ms)"
    default 1
    range 0 10
    help
      Slack subtracted from the cooperative-hop deadline on the dongle
      side to account for esb_stop_rx → esb_set_rf_channel → esb_start_rx.
      The endpoint's bare esb_set_rf_channel is faster, so the dongle
      starts its switch this many ms early to land at the radio-on
      instant when the endpoint also flips.

config DONGLE_COOP_HOP_COOLDOWN_MS
    int "Cooperative hop: minimum interval between two coop hops (ms)"
    default 2500
    range 100 30000
    help
      After a cooperative hop commits on the dongle side, set
      m_spec_cooldown_until to suppress speculative hops for this long.
      Should match the endpoint's
      ZMK_ESB_ENDPOINT_COOP_HOP_COOLDOWN_MS so both sides settle on
      the same cadence.

config DONGLE_COOP_HOP_QUARANTINE_MS
    int "Cooperative hop: quarantine hold for the channel just left (ms)"
    default 120000
    range 100 600000
    help
      Mirrors ZMK_ESB_ENDPOINT_COOP_HOP_QUARANTINE_MS on the dongle
      side. Coop hops fire on transient interference; the full
      CHANNEL_QUARANTINE_MS would over-punish a channel that is about
      to recover. Should match the endpoint value so both sides agree
      on which channels are eligible.

config DONGLE_COOP_HOP_VALIDATE_MS
    int "Cooperative-hop validation window (ms)"
    default 110
    range 50 1000
    help
      After the dongle commits a coop hop, it waits this long for any
      RX (HID, PROPOSAL, IDLE) on the new channel. RX confirms the
      endpoint joined; the deferred old-channel quarantine then fires.
      No RX means the endpoint missed our ACCEPT ACK and stayed on the
      old channel — the dongle reverts to the old channel directly,
      avoiding the rollback-dwell blackout. Sizing: endpoint first
      post-hop PROPOSAL lands at ≈ COOP_HOP_HOP_IN_MS +
      ZMK_ESB_ENDPOINT_CHANNEL_HOP_POST_QUIET_MS after OFFER RX, then
      every CHANNEL_HOP_POST_BURST_INTERVAL_MS; this window must span
      enough of those intervals to catch at least one PROPOSAL. Must be
      ≤ CHANNEL_HOP_ROLLBACK_SILENCE_MS so the validate path always
      preempts the rollback path.

config DONGLE_CHANNEL_PEEK_IDLE
    bool "Periodically peek at default channel while peer is idle"
    default y
    help
      While paired with the peer flagged idle (ESB_PKT_IDLE received)
      and the dongle parked on a non-default channel, briefly hop to
      DONGLE_ESB_RF_CHANNEL every CHANNEL_PEEK_IDLE_INTERVAL_MS and
      listen for CHANNEL_PEEK_IDLE_DWELL_MS. If any packet arrives the
      link resumes on the default channel; otherwise the dongle reverts.
      The existing rollback dwell cycle covers the same "keyboard
      rebooted onto default" case but is gated on !peer_idle, so long
      idle windows have no equivalent recovery without this.

config DONGLE_CHANNEL_PEEK_IDLE_INTERVAL_MS
    int "Interval between idle peeks (ms)"
    default 20
    range 20 1000
    depends on DONGLE_CHANNEL_PEEK_IDLE
    help
      Time between successive peeks. Shorter values recover a rebooted
      peer faster at the cost of more stop_rx → set_rf_channel →
      start_rx churn.

config DONGLE_CHANNEL_PEEK_IDLE_DWELL_MS
    int "Duration of each peek on the default channel (ms)"
    default 1
    range 1 200
    depends on DONGLE_CHANNEL_PEEK_IDLE
    help
      How long to listen on the default channel per peek. Must be
      long enough to catch at least one endpoint-side retry burst.
      Short dwells reduce missed HID latency if the peer wakes up on
      the original channel during a peek (endpoint TX-fail retry will
      fire another burst when the dongle reverts, so a missed first
      packet is bounded recovery, not a lost wake-up).

endif # DONGLE_CHANNEL_HOP

config DONGLE_LINK_STATS_INTERVAL_RX
    int "RX packets between LINK_STATS ACK queueings"
    default 16
    range 1 1024
    help
      How many RX packets must arrive before the dongle queues an
      ESB_PKT_LINK_STATS ACK payload carrying the peer's view of RSSI
      (last + EWMA). At the keyboard's 1 kHz HID rate a value of 16
      places ~60 stats updates per second into the ACK stream — enough
      to drive adaptive-retransmit decisions without flooding. Set
      higher to reduce ACK-channel contention if the keyboard queues
      non-HID control traffic (shell, bench) heavily.

config DONGLE_ESB_RX_MSGQ_DEPTH
    int "ESB RX message queue depth (packets)"
    default 32
    range 4 128
    help
      Number of slots in the queue between the ESB event handler (ISR) and
      the dispatch thread. Must be deep enough to hold a burst of back-to-back
      RX packets; if full, packets are dropped.

config DONGLE_ESB_RX_STACK_SIZE
    int "ESB RX thread stack size (bytes)"
    default 2048
    range 512 8192

config DONGLE_ESB_RX_THREAD_PRIORITY
    int "ESB RX thread cooperative priority"
    default 2
    range 0 13

config DONGLE_HID_REPORT_ID_KB
    int "HID keyboard report ID"
    default 1
    range 1 15

config DONGLE_HID_REPORT_ID_CONSUMER
    int "HID consumer report ID"
    default 2
    range 1 15

config DONGLE_HID_REPORT_ID_MOUSE
    int "HID mouse report ID"
    default 3
    range 1 15

config DONGLE_MOUSE_BUTTON_COUNT
    int "Number of mouse buttons in HID report"
    default 5
    range 1 8

config DONGLE_USB_TX_QUEUE_DEPTH
    int "USB HID TX queue depth"
    default 64
    range 2 128

config DONGLE_SHELL_RELAY
    bool "ESB shell relay on dongle"
    default y
    help
      Single button press when paired requests a shell session from the
      keyboard over ESB. I/O is forwarded via USB CDC UART.

config DONGLE_SHELL_RELAY_INACTIVITY_S
    int "Dongle shell relay inactivity timeout (seconds, 0 = disabled)"
    default 60
    range 0 3600
    depends on DONGLE_SHELL_RELAY
    help
      Stop the shell relay session if no SHELL_POLL or SHELL_DATA is received
      from the keyboard for this many seconds. 0 disables the timeout.

config DONGLE_SHELL_RELAY_INPUT_BUF_SIZE
    int "Shell relay CDC input ring buffer size (bytes)"
    default 256
    range 64 4096
    depends on DONGLE_SHELL_RELAY

config DONGLE_SHELL_RELAY_FIFO_FULL_RETRY_MS
    int "Shell relay retry delay when ESB ACK FIFO is full (ms)"
    default 2000
    range 100 10000
    depends on DONGLE_SHELL_RELAY

config DONGLE_SHELL_RELAY_RETRY_MS
    int "Shell relay SHELL_REQ retry interval (ms)"
    default 200
    range 50 5000
    depends on DONGLE_SHELL_RELAY

config DONGLE_SHELL_RELAY_POLL_WATCHDOG_MS
    int "Shell relay poll watchdog timeout (ms, 0 = disabled)"
    default 1000
    range 0 30000
    depends on DONGLE_SHELL_RELAY
    help
      If no SHELL_POLL is received from the keyboard for this many ms while
      a shell session is active and confirmed, the dongle assumes the
      keyboard has gone away (e.g. endpoint switched to BLE), flushes the
      stale ACK FIFO, and re-issues SHELL_REQ so the session recovers when
      the keyboard comes back. 0 disables the watchdog.


config DONGLE_SHELL_RELAY_OUTPUT_BUF_SIZE
    int "Shell relay CDC output ring buffer size (bytes)"
    default 2048
    range 256 8192
    depends on DONGLE_SHELL_RELAY
    help
      Buffers keyboard shell output before writing to the CDC UART TX FIFO.
      Prevents bytes from being dropped when a USB bulk-IN transfer is already
      in flight. Must be larger than CONFIG_USB_CDC_ACM_RINGBUF_SIZE.

config DONGLE_SHELL_RELAY_TX_CHUNK_MAX
    int "Max bytes per uart_fifo_fill call when draining output ring"
    default 64
    range 16 256
    depends on DONGLE_SHELL_RELAY

config DONGLE_SHELL_RELAY_ALWAYS_ON
    bool "Always-on shell relay"
    default n
    depends on DONGLE_SHELL_RELAY
    help
      When enabled: the relay is not disconnected on inactivity, the
      dongle re-initiates the relay automatically if the keyboard drops
      it (ESB_PKT_SHELL_STOP), and the relay is requested immediately
      on connection (pairing complete or known peer at boot).

# ---- ESB Kconfig (mirrors nrf/subsys/esb/Kconfig) ----

config ESB
    bool "Enhanced ShockBurst"
    default y

if ESB

config ESB_MAX_PAYLOAD_LENGTH
    int "Maximum ESB payload size"
    default 32
    range 1 32

config ESB_TX_FIFO_SIZE
    int "ESB TX FIFO depth"
    default 24

config ESB_RX_FIFO_SIZE
    int "ESB RX FIFO depth"
    default 64

config ESB_PIPE_COUNT
    int "ESB pipe count"
    default 2
    range 1 8

config ESB_RADIO_IRQ_PRIORITY
    int "ESB radio interrupt priority"
    default 1

config ESB_EVENT_IRQ_PRIORITY
    int "ESB event interrupt priority"
    default 2

config ESB_SYS_TIMER2
    bool
    default y

config ESB_SYS_TIMER_INSTANCE
    int
    default 2

config ESB_SYS_TIMER_INSTANCE_LEADING_ZERO
    bool
    default n

config ESB_DYNAMIC_INTERRUPTS
    bool "ESB dynamic interrupt support"
    default y

config ESB_NEVER_DISABLE_TX
    bool
    default n

config ESB_FAST_SWITCHING
    bool
    default n

config ESB_FAST_CHANNEL_SWITCHING
    bool
    default n

module=ESB
module-str=ESB
source "${ZEPHYR_BASE}/subsys/logging/Kconfig.template.log_config"

endif # ESB
```

## prj.conf
```kconfig
CONFIG_USB_DEVICE_STACK=y
CONFIG_USB_DEVICE_HID=y
CONFIG_USB_HID_POLL_INTERVAL_MS=1

CONFIG_GPIO=y
CONFIG_GPIO_NRFX=y

CONFIG_SPI=y
CONFIG_LED_STRIP=y
CONFIG_WS2812_STRIP=y

CONFIG_SETTINGS=y
CONFIG_SETTINGS_NVS=y
CONFIG_NVS=y
CONFIG_FLASH=y
CONFIG_FLASH_PAGE_LAYOUT=y
CONFIG_FLASH_MAP=y

CONFIG_NRFX_PPI=y
CONFIG_NRFX_TIMER2=y
CONFIG_DYNAMIC_INTERRUPTS=y
CONFIG_DYNAMIC_DIRECT_INTERRUPTS=y

CONFIG_LOG=y
CONFIG_LOG_DEFAULT_LEVEL=3
CONFIG_LOG_BUFFER_SIZE=1024
CONFIG_LOG_PROCESS_THREAD_SLEEP_MS=50
CONFIG_LOG_PROCESS_THREAD_STARTUP_DELAY_MS=600

CONFIG_SERIAL=y
CONFIG_CONSOLE=y
CONFIG_UART_CONSOLE=y
CONFIG_UART_LINE_CTRL=y
CONFIG_USB_CDC_ACM_RINGBUF_SIZE=1024
CONFIG_USB_CDC_ACM_LOG_LEVEL_OFF=y
CONFIG_USB_DRIVER_LOG_LEVEL_OFF=y

CONFIG_MAIN_STACK_SIZE=2048
CONFIG_SYSTEM_WORKQUEUE_STACK_SIZE=2048

CONFIG_DONGLE_ESB_RF_CHANNEL=78
CONFIG_DONGLE_SHELL_RELAY_ALWAYS_ON=n
CONFIG_DONGLE_SHELL_RELAY_INACTIVITY_S=60
CONFIG_DONGLE_NO_ACTIVE_EFFECTS=n
```

## boards/holyiot_dongle_1k.conf
```kconfig
CONFIG_DONGLE_NOLED=y
CONFIG_DONGLE_SHELL_RELAY_ALWAYS_ON=y

CONFIG_SPI=n
CONFIG_LED_STRIP=n
CONFIG_WS2812_STRIP=n
```

## boards/efogtech_dongle_1k.overlay
```dts
&cdc_acm_console_uart {
	current-speed = <460800>;
};

#ifdef CONFIG_DONGLE_NOLED
&led_strip {
	status = "disabled";
};
#endif
```

## src/main.c
```c
/*
 * Copyright (c) 2025 efogdev
 * SPDX-License-Identifier: MIT
 *
 * Dongle main: ESB PRX → USB HID forwarding with simple pairing state machine.
 *
 * Pairing state:
 *   UNPAIRED  — no stored peer; button press arms pairing
 *   PAIRING   — arming: will respond to next BEACON with PAIR_REQ in ACK
 *   VERIFYING — stored peer, no verified session this boot; HID suppressed
 *               until a matching VERIFY_REQ arrives
 *   PAIRED    — verified session; HID reports on pipe 1 forwarded to USB HID
 *
 * Mutual verification: keyboard's FICR device_id is captured in PAIR_RESP
 * and persisted. On reconnect the dongle boots into VERIFYING and only
 * promotes to PAIRED when VERIFY_REQ arrives from the stored peer. Strangers
 * get DISCONNECT and are ignored.
 *
 * Button (P0.29, active low):
 *   short press when UNPAIRED → arm pairing (PAIRING)
 *   hold 5s    when PAIRED   → forget peer (UNPAIRED)
 *
 * Boards without a pair_btn DT node skip all button handling and instead
 * auto-arm pairing at boot when no peer is stored. Unpair from such a
 * dongle must come from the keyboard (DISCONNECT).
 */

#include <zephyr/kernel.h>
#include <zephyr/device.h>
#include <zephyr/drivers/gpio.h>
#include <zephyr/settings/settings.h>
#include <hal/nrf_ficr.h>
#include <string.h>

#include <zmk_esb/protocol.h>
#include "esb_prx.h"
#include "usb_hid.h"
#include "led_status.h"
#include "shell_relay.h"
#include "bench.h"
#if IS_ENABLED(CONFIG_DONGLE_CHANNEL_HOP)
#include "channel_hop_dongle.h"
#endif

#include <zephyr/logging/log.h>
LOG_MODULE_REGISTER(dongle_main, LOG_LEVEL_INF);

#define SETTINGS_KEY  "dongle/paired"

typedef enum {
    STATE_UNPAIRED,
    STATE_PAIRING,
    STATE_VERIFYING,
    STATE_PAIRED,
} dongle_state_t;

/* Persisted pairing record. A length mismatch on load (e.g. the pre-mutual
 * single-byte format) silently wipes it so we boot as UNPAIRED. */
struct dongle_paired_rec {
    uint8_t paired;
    uint8_t peer_device_id[6];
} __attribute__((__packed__));

static dongle_state_t m_state = STATE_UNPAIRED;
static bool m_has_peer;
static uint8_t m_device_id[6];
static uint8_t m_peer_device_id[6];

static void build_device_id(void) {
    const uint32_t lo = nrf_ficr_deviceid_get(NRF_FICR, 0);
    const uint32_t hi = nrf_ficr_deviceid_get(NRF_FICR, 1);
    memcpy(&m_device_id[0], &lo, 4);
    memcpy(&m_device_id[4], &hi, 2);
}

#define KB_REPORT_LEN       8
#define CONSUMER_REPORT_LEN 2
#define MOUSE_REPORT_LEN    9

static int settings_load_cb(const char *name, size_t len, const settings_read_cb read_cb, void *cb_arg) {
    if (len != sizeof(struct dongle_paired_rec)) {
        LOG_WRN("unexpected settings record length %zu, dropping", len);
        return 0;
    }
    struct dongle_paired_rec rec;
    read_cb(cb_arg, &rec, sizeof(rec));
    m_has_peer = (rec.paired == 1);
    memcpy(m_peer_device_id, rec.peer_device_id, sizeof(m_peer_device_id));
    return 0;
}

SETTINGS_STATIC_HANDLER_DEFINE(dongle, "dongle", NULL, settings_load_cb, NULL, NULL);

static void save_paired(const bool paired) {
    struct dongle_paired_rec rec = { .paired = paired ? 1 : 0 };
    if (paired) {
        memcpy(rec.peer_device_id, m_peer_device_id, sizeof(rec.peer_device_id));
    }
    settings_save_one(SETTINGS_KEY, &rec, sizeof(rec));
    m_has_peer = paired;
    if (!paired) {
        memset(m_peer_device_id, 0, sizeof(m_peer_device_id));
    }
    led_status_set_paired(paired);
}

#define HAS_PAIR_BTN DT_NODE_EXISTS(DT_NODELABEL(pair_btn))

#if HAS_PAIR_BTN
static const struct gpio_dt_spec btn = GPIO_DT_SPEC_GET(DT_NODELABEL(pair_btn), gpios);
static struct gpio_callback btn_cb_data;
static struct k_work btn_work;
static struct k_work_delayable long_press_work;
static bool btn_was_pressed;
static bool long_press_fired;

static void long_press_work_fn(struct k_work *w) {
    long_press_fired = true;
    if (m_state == STATE_PAIRED || m_state == STATE_VERIFYING) {
        LOG_INF("Button held 5s: forget peer, UNPAIRED");
        save_paired(false);
        m_state = STATE_UNPAIRED;
        led_status_set_armed(false);
#if IS_ENABLED(CONFIG_DONGLE_CHANNEL_HOP)
        channel_hop_dongle_set_paired(false);
#endif
        /* Tell the keyboard to unpair. Queue one DISCONNECT ACK payload;
         * it will be delivered on the next keyboard TX. Don't rely on the
         * HID_REPORT handler for this — see below. */
        struct esb_pkt_disconnect d = { .type = ESB_PKT_DISCONNECT };
        esb_prx_queue_ack(1, (uint8_t *)&d, sizeof(d));
    }
}

static void btn_work_fn(struct k_work *w) {
    const bool pressed = (gpio_pin_get_dt(&btn) == 1);
    if (pressed && !btn_was_pressed) {
        btn_was_pressed = true;
        long_press_fired = false;
        k_work_schedule(&long_press_work, K_MSEC(CONFIG_DONGLE_UNPAIR_HOLD_MS));
    } else if (!pressed && btn_was_pressed) {
        btn_was_pressed = false;
        k_work_cancel_delayable(&long_press_work);
        if (!long_press_fired && m_state == STATE_UNPAIRED) {
            LOG_INF("Button short press: arm pairing (UNPAIRED -> PAIRING)");
            m_state = STATE_PAIRING;
            led_status_set_armed(true);
        } else if (!long_press_fired && m_state == STATE_PAIRED) {
            LOG_INF("Button short press: request shell relay");
            shell_relay_request();
        }
        
    }
}

static void btn_isr(const struct device *dev, struct gpio_callback *cb, uint32_t pins) {
    k_work_submit(&btn_work);
}
#endif /* HAS_PAIR_BTN */

static void on_esb_rx(const uint8_t pipe, const uint8_t *data, const uint8_t len) {
    if (len < 1) {
        return;
    }

    led_status_mark_rx();
    LOG_DBG("packet type %d", data[0]);

#if IS_ENABLED(CONFIG_DONGLE_CHANNEL_HOP)
    /* Cooperative-hop OFFER must be parsed BEFORE note_rx_active —
     * the rejection logic in on_rx_offer inspects m_speculative_prev
     * and m_rollback_active before they get cleared by note_rx_active's
     * confirm_speculative_if_any / exit_rollback. After the parse,
     * the OFFER counts as any other non-IDLE packet and rearms the
     * watchdog via the normal note_rx_active path below. */
    if (data[0] == ESB_PKT_HOP_OFFER) {
        channel_hop_dongle_on_rx_offer(data, len);
    }

    /* Drive peer-idle tracking from the RX path. IDLE specifically flags
     * the peer as idle and disarms the silence watchdog; every other
     * packet type (including control packets like VERIFY_REQ and
     * CHANNEL_HOP_PROPOSAL) means the peer is still transmitting, so
     * rearm the watchdog. */
    if (data[0] == ESB_PKT_IDLE) {
        channel_hop_dongle_note_rx_idle();
    } else {
        channel_hop_dongle_note_rx_active();
    }
#endif

    switch (data[0]) {
    case ESB_PKT_BEACON:
        if (m_state == STATE_PAIRING) {
            LOG_INF("BEACON rx in PAIRING: queuing PAIR_REQ in ACK");
            struct esb_pkt_pair_req req = { .type = ESB_PKT_PAIR_REQ };
            memcpy(req.device_id, m_device_id, sizeof(req.device_id));
            esb_prx_queue_ack(0, (uint8_t *)&req, sizeof(req));
        }
        break;

    case ESB_PKT_PAIR_RESP:
        if (m_state == STATE_PAIRING && len >= sizeof(struct esb_pkt_pair_resp)) {
            const struct esb_pkt_pair_resp *pkt = (const void *)data;
            memcpy(m_peer_device_id, pkt->device_id, sizeof(m_peer_device_id));
            LOG_INF("PAIR_RESP: paired with %02X%02X%02X%02X%02X%02X",
                    m_peer_device_id[0], m_peer_device_id[1], m_peer_device_id[2],
                    m_peer_device_id[3], m_peer_device_id[4], m_peer_device_id[5]);
            save_paired(true);
            m_state = STATE_PAIRED;
            led_status_set_armed(false);
#if IS_ENABLED(CONFIG_DONGLE_CHANNEL_HOP)
            channel_hop_dongle_set_paired(true);
#endif
            if (IS_ENABLED(CONFIG_DONGLE_SHELL_RELAY_ALWAYS_ON)) {
                shell_relay_request();
            }
        }
        break;

    case ESB_PKT_HID_REPORT: {
        /* STATE_VERIFYING deliberately drops HID — a stranger keyboard that
         * skips the verify handshake must not reach the host. When we're in
         * VERIFYING but the keyboard is still sending HID (i.e. it's stuck in
         * CONNECTED from a previous session because we rebooted), queue a
         * RESYNC so it falls back to VERIFYING and re-runs the handshake. */
        if (m_state == STATE_VERIFYING) {
            struct esb_pkt_resync r = { .type = ESB_PKT_RESYNC };
            esb_prx_queue_ack(1, (uint8_t *)&r, sizeof(r));
            break;
        }
        if (m_state != STATE_PAIRED || len < 2) {
            break;
        }

        const struct esb_pkt_hid_report *pkt = (const void *)data;
        uint8_t report_id;
        uint8_t report_len;

        switch (pkt->report_type) {
        case ESB_REPORT_KEYBOARD:
            report_id  = CONFIG_DONGLE_HID_REPORT_ID_KB;
            report_len = KB_REPORT_LEN;
            break;
        case ESB_REPORT_CONSUMER:
            report_id  = CONFIG_DONGLE_HID_REPORT_ID_CONSUMER;
            report_len = CONSUMER_REPORT_LEN;
            break;
        case ESB_REPORT_MOUSE:
            report_id  = CONFIG_DONGLE_HID_REPORT_ID_MOUSE;
            report_len = MOUSE_REPORT_LEN;
            break;
        default:
            return;
        }

        if (pkt->report_type == ESB_REPORT_KEYBOARD) {
            LOG_DBG("RX KB: mod=%02X k=%02X %02X %02X %02X %02X %02X",
                    pkt->data[0], pkt->data[2], pkt->data[3], pkt->data[4],
                    pkt->data[5], pkt->data[6], pkt->data[7]);
        } else if (pkt->report_type == ESB_REPORT_CONSUMER) {
            LOG_DBG("RX CONS: %02X %02X", pkt->data[0], pkt->data[1]);
        }

        const int send_err = usb_hid_send(report_id, pkt->data, report_len);
        if (send_err) {
            LOG_WRN("usb_hid_send(id=%u) dropped: %d", report_id, send_err);
        }
        break;
    }

    case ESB_PKT_DISCONNECT:
        LOG_INF("DISCONNECT from keyboard, forgetting peer (-> UNPAIRED)");
        save_paired(false);
        m_state = STATE_UNPAIRED;
        led_status_set_armed(false);
#if IS_ENABLED(CONFIG_DONGLE_CHANNEL_HOP)
        channel_hop_dongle_set_paired(false);
#endif
        shell_relay_stop();
        break;

    case ESB_PKT_SHELL_DATA:
        if (len >= 2) {
            shell_relay_on_rx_data((const struct esb_pkt_shell_data *)data);
        }
        break;

    case ESB_PKT_SHELL_STOP:
        LOG_INF("SHELL_STOP rx, ending shell session");
        shell_relay_stop();
        if (IS_ENABLED(CONFIG_DONGLE_SHELL_RELAY_ALWAYS_ON) && m_state == STATE_PAIRED) {
            shell_relay_request();
        }
        break;

    case ESB_PKT_SHELL_POLL:
        shell_relay_on_keyboard_ack();
        break;

    case ESB_PKT_SHELL_BG_POLL:
        shell_relay_on_keyboard_bg_poll();
        break;

#if IS_ENABLED(CONFIG_DONGLE_CHANNEL_HOP)
    case ESB_PKT_CHANNEL_HOP_PROPOSAL:
        /* Only act on channel hop proposals from a verified peer — a
         * stranger keyboard must not be able to move our radio off the
         * pairing channel. */
        if (m_state == STATE_PAIRED) {
            channel_hop_dongle_on_rx_proposal(data, len);
        }
        break;
#endif

    case ESB_PKT_SHELL_START:
        /* Keyboard-triggered shell session (via &esb_shell_req behavior).
         * Mirrors the dongle pair-button short-press: spin up the CDC side,
         * queue SHELL_REQ in the next ACK so the keyboard flips into
         * active shell mode. Idempotent — shell_relay_request() no-ops if
         * already active. Gated on STATE_PAIRED so a stranger cannot coax
         * the dongle into enabling CDC I/O. */
        if (m_state == STATE_PAIRED) {
            LOG_INF("SHELL_START from keyboard, starting relay");
            shell_relay_request();
        }
        break;

    case ESB_PKT_VERIFY_REQ: {
        if (len < sizeof(struct esb_pkt_verify_req)) {
            break;
        }
        const struct esb_pkt_verify_req *req = (const void *)data;
        const bool sender_matches = (memcmp(req->device_id, m_peer_device_id,
                                            sizeof(m_peer_device_id)) == 0);

        if (m_state == STATE_VERIFYING && sender_matches) {
            struct esb_pkt_verify_resp resp = { .type = ESB_PKT_VERIFY_RESP };
            memcpy(resp.device_id, m_device_id, sizeof(resp.device_id));
            esb_prx_queue_ack(1, (uint8_t *)&resp, sizeof(resp));
            m_state = STATE_PAIRED;
            LOG_INF("VERIFY_REQ matched peer, session verified");
#if IS_ENABLED(CONFIG_DONGLE_CHANNEL_HOP)
            channel_hop_dongle_set_paired(true);
#endif
            if (IS_ENABLED(CONFIG_DONGLE_SHELL_RELAY_ALWAYS_ON)) {
                shell_relay_request();
            }
        } else if (m_state == STATE_PAIRED && sender_matches) {
            /* Already verified this boot; keyboard retrying while our
             * VERIFY_RESP is still in flight. Answer idempotently. */
            struct esb_pkt_verify_resp resp = { .type = ESB_PKT_VERIFY_RESP };
            memcpy(resp.device_id, m_device_id, sizeof(resp.device_id));
            esb_prx_queue_ack(1, (uint8_t *)&resp, sizeof(resp));
        } else {
            /* Unknown or non-matching sender. Covers:
             *   STATE_UNPAIRED           — settings were wiped
             *   STATE_{VERIFYING,PAIRED} — stranger keyboard with shared
             *                              ESB addresses
             * Nudge the sender to UNPAIRED so it stops spamming. */
            LOG_WRN("VERIFY_REQ from stranger %02X%02X%02X%02X%02X%02X, rejecting",
                    req->device_id[0], req->device_id[1], req->device_id[2],
                    req->device_id[3], req->device_id[4], req->device_id[5]);
            struct esb_pkt_disconnect d = { .type = ESB_PKT_DISCONNECT };
            esb_prx_queue_ack(1, (uint8_t *)&d, sizeof(d));
        }
        break;
    }

    case ESB_PKT_BENCH_PING:
        if (m_state == STATE_PAIRED) {
            bench_on_ping(esb_prx_get_last_rssi());
        }
        break;

    case ESB_PKT_BENCH_STOP:
        if (m_state == STATE_PAIRED) {
            bench_on_stop();
        }
        break;

    default:
        break;
    }

#if IS_ENABLED(CONFIG_DONGLE_CHANNEL_HOP)
    /* Post-dispatch hook: any inbound packet that didn't populate
     * committed_next is an opportunity to ride the next outbound ACK
     * with a REQUEST so the endpoint sends a fresh PROPOSAL on its
     * next TX. Runs after on_rx_proposal so a successful PROPOSAL is
     * not immediately followed by a redundant REQUEST. */
    channel_hop_dongle_after_rx(pipe);
#endif

    /* Periodic link-stats telemetry in the ACK stream. Opportunistic —
     * no-op unless the per-RX counter has crossed its interval. Last
     * in the RX flow so higher-priority ACK queueings (HOP_ACCEPT,
     * VERIFY_RESP, etc.) already sit ahead in the FIFO. */
    if (m_state == STATE_PAIRED) {
        esb_prx_maybe_queue_link_stats();
    }
}

int main(void) {
    int err;

    build_device_id();
    LOG_INF("dongle device_id: %02X%02X%02X%02X%02X%02X",
            m_device_id[0], m_device_id[1], m_device_id[2],
            m_device_id[3], m_device_id[4], m_device_id[5]);

    settings_subsys_init();
    settings_load_subtree("dongle");

    if (m_has_peer) {
        LOG_INF("Known peer %02X%02X%02X%02X%02X%02X, VERIFYING",
                m_peer_device_id[0], m_peer_device_id[1], m_peer_device_id[2],
                m_peer_device_id[3], m_peer_device_id[4], m_peer_device_id[5]);
        m_state = STATE_VERIFYING;
    } else {
        LOG_INF("No peer, UNPAIRED — press button to pair");
    }

    err = led_status_init();
    if (err) {
        LOG_ERR("LED status init: %d", err);
    }
    led_status_set_paired(m_has_peer);

#if HAS_PAIR_BTN
    k_work_init(&btn_work, btn_work_fn);
    k_work_init_delayable(&long_press_work, long_press_work_fn);

    if (!device_is_ready(btn.port)) {
        LOG_ERR("GPIO not ready");
        return -ENODEV;
    }
    gpio_pin_configure_dt(&btn, GPIO_INPUT);
    gpio_pin_interrupt_configure_dt(&btn, GPIO_INT_EDGE_BOTH);
    gpio_init_callback(&btn_cb_data, btn_isr, BIT(btn.pin));
    gpio_add_callback(btn.port, &btn_cb_data);
#else
    if (!m_has_peer) {
        LOG_INF("No pair button on board: auto-arming pairing");
        m_state = STATE_PAIRING;
        led_status_set_armed(true);
    }
#endif

    err = usb_hid_dongle_init();
    if (err) {
        LOG_ERR("USB HID init: %d", err);
        return err;
    }
    LOG_INF("USB HID init OK");

    err = esb_prx_init(on_esb_rx);
    if (err) {
        LOG_ERR("ESB PRX init: %d", err);
        return err;
    }
    LOG_INF("ESB PRX init OK on channel %u", CONFIG_DONGLE_ESB_RF_CHANNEL);

#if IS_ENABLED(CONFIG_DONGLE_CHANNEL_HOP)
    channel_hop_dongle_init(CONFIG_DONGLE_ESB_RF_CHANNEL);
    LOG_INF("channel hop enabled, initial channel %u", CONFIG_DONGLE_ESB_RF_CHANNEL);
#endif

    shell_relay_init();

    /* No boot-time shell_relay kick: STATE_VERIFYING must not emit anything
     * until the peer checks in. The kick happens on the VERIFYING → PAIRED
     * transition (fresh pair or matching VERIFY_REQ). */

    return 0;
}
```

## src/bench.c
```c
/*
 * Copyright (c) 2025 efogdev
 * SPDX-License-Identifier: MIT
 */

#include <zephyr/kernel.h>
#include <zmk_esb/protocol.h>
#include "bench.h"
#include "esb_prx.h"

#include <zephyr/logging/log.h>
LOG_MODULE_REGISTER(dongle_bench, LOG_LEVEL_INF);

static int32_t m_rssi_sum;
static int8_t  m_rssi_min;
static int8_t  m_rssi_max;
static uint32_t m_rx_count;
static bool m_active;

/* Saved result so repeated BENCH_STOP re-queues the same ACK payload.
 * The keyboard keeps sending pings while STOPPING; the dongle needs a
 * stable result to put in each ACK until the keyboard sees it. */
static struct esb_pkt_bench_result m_saved_result;
static bool m_result_ready;

void bench_on_ping(const int8_t rssi) {
    if (!m_active) {
        /* First ping of a new run — reset everything. */
        LOG_INF("Bench: run started (first ping rssi=%d)", rssi);
        m_active       = true;
        m_result_ready = false;
        m_rssi_sum     = rssi;
        m_rx_count     = 1;
        m_rssi_min     = rssi;
        m_rssi_max     = rssi;
        return;
    }
    m_rssi_sum += rssi;
    m_rx_count++;
    if (rssi < m_rssi_min) {
        m_rssi_min = rssi;
    }
    if (rssi > m_rssi_max) {
        m_rssi_max = rssi;
    }
}

void bench_on_stop(void) {
    if (!m_result_ready) {
        m_saved_result.type = ESB_PKT_BENCH_RESULT;
        if (m_active && m_rx_count > 0) {
            m_saved_result.rssi_avg = (int8_t)(m_rssi_sum / (int32_t)m_rx_count);
            m_saved_result.rssi_min = m_rssi_min;
            m_saved_result.rssi_max = m_rssi_max;
            m_saved_result.rx_count = m_rx_count;
            LOG_INF("Bench: %u pings, RSSI avg=%d min=%d max=%d",
                    m_rx_count, (int)m_saved_result.rssi_avg,
                    (int)m_saved_result.rssi_min, (int)m_saved_result.rssi_max);
        } else {
            m_saved_result.rssi_avg = 0;
            m_saved_result.rssi_min = 0;
            m_saved_result.rssi_max = 0;
            m_saved_result.rx_count = 0;
            LOG_WRN("Bench: BENCH_STOP received but no pings accumulated");
        }
        m_result_ready = true;
        m_active       = false;
    }

    /* Re-queue on every BENCH_STOP so the keyboard's next ping carries it. */
    esb_prx_queue_ack(1, (uint8_t *)&m_saved_result, sizeof(m_saved_result));
}
```

## src/bench.h
```c
/*
 * Copyright (c) 2025 efogdev
 * SPDX-License-Identifier: MIT
 */

#pragma once

#include <stdint.h>

void bench_on_ping(const int8_t rssi);
void bench_on_stop(void);
```

## src/channel_hop_dongle.h
```c
/*
 * Copyright (c) 2025 efogdev
 * SPDX-License-Identifier: MIT
 *
 * Dongle-side (PRX) channel-hop manager. Owns quarantine + committed-next
 * state, plus a peer-idle flag fed by ESB_PKT_IDLE that gates the silence
 * watchdog so a genuinely idle link (user away / BLE slot switched) does
 * not trigger spurious hops.
 */

#pragma once

#include <stdint.h>
#include <stdbool.h>

void channel_hop_dongle_init(uint8_t initial_channel);

/* Called from main.c when the dongle enters/leaves STATE_PAIRED. The
 * silence watchdog only runs while paired; otherwise PAIR_REQ / VERIFY
 * traffic would constantly rearm or drop it during the handshake. */
void channel_hop_dongle_set_paired(bool paired);

/* RX dispatch helpers called from main.c on_esb_rx.
 *   note_rx_active: any packet OTHER than ESB_PKT_IDLE. Flags peer not
 *     idle and rearms the watchdog.
 *   note_rx_idle:   ESB_PKT_IDLE specifically. Flags peer idle and
 *     cancels the watchdog.
 */
void channel_hop_dongle_note_rx_active(void);
void channel_hop_dongle_note_rx_idle(void);

/* RX dispatch for CHANNEL_HOP_PROPOSAL packets. Updates committed_next
 * and queues a CHANNEL_HOP_CONFIRM ACK payload on pipe 1. */
void channel_hop_dongle_on_rx_proposal(const uint8_t *data, uint8_t len);

/* RX dispatch for HOP_OFFER (cooperative-hop handshake start). MUST be
 * called BEFORE channel_hop_dongle_note_rx_active() in the on_esb_rx
 * dispatch path — the rejection logic inspects m_speculative_prev /
 * m_rollback_active before they get cleared by note_rx_active. Queues
 * a HOP_ACCEPT in the pipe-1 ACK and arms the commit timer for
 * (hop_in_ms - PRX_SETUP_BUDGET_MS) from now. */
void channel_hop_dongle_on_rx_offer(const uint8_t *data, uint8_t len);

/* Called from main.c after every inbound packet has been fully dispatched
 * (so on_rx_proposal has had a chance to populate committed_next first).
 * If committed_next is still INVALID and the peer is known-active, queues
 * an ESB_PKT_CHANNEL_HOP_REQUEST on the pipe-1 ACK so the endpoint sends
 * a fresh PROPOSAL on its next TX rather than waiting for its 60 s steady-
 * state cadence. No-op when the request would be redundant. */
void channel_hop_dongle_after_rx(uint8_t pipe);

/* Shell / debug getters. */
uint8_t channel_hop_dongle_get_committed(void);
uint8_t channel_hop_dongle_get_quarantine_count(void);
bool    channel_hop_dongle_is_quarantined(uint8_t channel);
bool    channel_hop_dongle_is_peer_idle(void);
```

## src/esb_prx.h
```c
/*
 * Copyright (c) 2025 efogdev
 * SPDX-License-Identifier: MIT
 */

#pragma once

#include <stdint.h>
#include <stdbool.h>

typedef void (*esb_prx_rx_cb_t)(uint8_t pipe, const uint8_t *data, uint8_t len);

int    esb_prx_init(esb_prx_rx_cb_t cb);
int    esb_prx_queue_ack(uint8_t pipe, const uint8_t *data, uint8_t len);
int    esb_prx_flush_acks(void);
int8_t esb_prx_get_last_rssi(void);

/* EWMA of RX RSSI in dBm. Returns 0 before any RX has been observed. */
int8_t esb_prx_get_rssi_ewma(void);

/* Queue an ESB_PKT_LINK_STATS ACK payload if enough RXes have accumulated
 * since the last queueing (CONFIG_DONGLE_LINK_STATS_INTERVAL_RX). Called
 * from the RX dispatch thread after every received packet — cheap no-op
 * when the interval has not elapsed. Returns 0 on successful queue or
 * skip; negative errno if the ACK queue rejected the payload. */
int    esb_prx_maybe_queue_link_stats(void);

/* Current RF channel. */
uint8_t esb_prx_get_channel(void);

/* Change the active RF channel: stop RX, apply channel, restart RX.
 * Must not be called from ISR context. */
int esb_prx_set_channel(uint8_t channel);
```

## src/led_status.h
```c
/*
 * Copyright (c) 2025 efogdev
 * SPDX-License-Identifier: MIT
 */

#pragma once

#include <stdbool.h>

int  led_status_init(void);
void led_status_set_paired(bool paired);
void led_status_set_armed(bool armed);
void led_status_set_shell_relay(bool active);
void led_status_set_shell_pending(bool pending);
void led_status_mark_rx(void);

/* One-shot override: paint the status LED with CONFIG_DONGLE_LED_NOLINK_*
 * for CONFIG_DONGLE_LED_NOLINK_FLASH_MS. Fired on every channel hop
 * (speculative or cooperative) — both are symptoms of link degradation,
 * so they share a single visual cue. Safe to call from any context; a
 * later flash extends the deadline rather than stacking. */
void led_status_flash_nolink(void);

/* Solid override: while true, paint the status LED with
 * CONFIG_DONGLE_LED_NOLINK_* whenever the dongle is paired and not in a
 * shell relay state. Asserted by the channel-hop machinery when the peer
 * cannot be reached (rollback dwell, post-validate-fail revert window),
 * cleared on the next confirmed RX. */
void led_status_set_link_lost(bool lost);
```

## src/shell_relay.h
```c
/*
 * Copyright (c) 2025 efogdev
 * SPDX-License-Identifier: MIT
 */

#pragma once

#include <stdbool.h>
#include <zmk_esb/protocol.h>

void shell_relay_init(void);
void shell_relay_request(void);
void shell_relay_stop(void);
void shell_relay_on_rx_data(const struct esb_pkt_shell_data *pkt);
void shell_relay_on_keyboard_ack(void);     /* keyboard SHELL_POLL: active shell confirmed */
void shell_relay_on_keyboard_bg_poll(void); /* keyboard SHELL_BG_POLL: paired but not in shell */
bool shell_relay_is_active(void);
```

## src/usb_hid.h
```c
/*
 * Copyright (c) 2025 efogdev
 * SPDX-License-Identifier: MIT
 */

#pragma once

#include <stdint.h>

int usb_hid_dongle_init(void);
int usb_hid_send(uint8_t report_type, const uint8_t *data, uint8_t len);
```
